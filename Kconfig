## Kconfig
```kconfig
config OPENMV_RPC
    bool "Enable the OpenMV RPC library"
    depends on UART_ASYNC_API
    help
      This library can be used to interface with OpenMV devices through
      the OpenMV RPC protocol over UART.

if OPENMV_RPC

config OPENMV_RPC_RESULT_PAYLOAD_SIZE
    int "Maximum size of result payload"
    default 1024

endif
```
